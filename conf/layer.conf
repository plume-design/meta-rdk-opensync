## conf/layer.conf
```bitbake
# We have a conf and classes directory, append to BBPATH
BBPATH .= ":${LAYERDIR}"

# We have a recipes directory, add to BBFILES
BBFILES += "${LAYERDIR}/recipes/*/*.bb \
            ${LAYERDIR}/recipes/*/*.bbappend"

BBFILE_COLLECTIONS += "opensync"
BBFILE_PATTERN_opensync := "^${LAYERDIR}/"
BBFILE_PRIORITY_opensync = "7"

LAYERVERSION_opensync = "1"
LAYERDEPENDS_opensync = "rdk"
```
